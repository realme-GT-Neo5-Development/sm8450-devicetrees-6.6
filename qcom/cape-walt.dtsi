// SPDX-License-Identifier: BSD-3-Clause
/*
 * Copyright (c) 2023 Qualcomm Innovation Center, Inc. All rights reserved.
 *
 * CPU cycle counter for WALT. On 6.6 the counter is provided by the WALT
 * cycle-counter driver (qcom,epss) instead of qcom-cpufreq-hw; WALT waits
 * for it during init. Register ranges are the EPSS frequency domains of
 * cpufreq_hw in waipio-clock.dtsi.
 */

&soc {
	walt {
		#address-cells = <1>;
		#size-cells = <1>;
		ranges;

		qcom,cycle-cntr {
			compatible = "qcom,epss";
			reg = <0x17d91000 0x1000>,
			      <0x17d92000 0x1000>,
			      <0x17d93000 0x1000>;
			reg-names = "freq-domain0",
				    "freq-domain1",
				    "freq-domain2";
		};
	};
};

// SPDX-License-Identifier: BSD-3-Clause
/*
 * Copyright (c) Qualcomm Technologies, Inc. and/or its subsidiaries.
 */

/dts-v1/;

#include "cape.dtsi"

/ {
	model = "Qualcomm Technologies, Inc. Cape SoC";
	compatible = "qcom,cape";
	qcom,board-id = <0 0>;
};


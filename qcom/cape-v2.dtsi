// SPDX-License-Identifier: BSD-3-Clause
/*
 * Copyright (c) Qualcomm Technologies, Inc. and/or its subsidiaries.
 */

#include "cape.dtsi"

/ {
	model = "Qualcomm Technologies, Inc. Cape LTE";
	compatible = "qcom,cape";
	qcom,msm-id = <540 0x10000>;
};

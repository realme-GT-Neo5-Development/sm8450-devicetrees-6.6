/* Header is skipped when included from senna-22624-cape-full-overlay.dts. */
#ifndef SENNA_FULL_OVERLAY
/dts-v1/;
/plugin/;
#endif

#include "cape-sde-display-mtp.dtsi"

/ {
	model = "Qualcomm Technologies, Inc. Cape MTP";
	compatible = "qcom,cape-mtp", "qcom,cape", "qcom,mtp";
	qcom,msm-id = <530 0x10000>, <531 0x10000>, <540 0x10000>, <591 0x10000>;
	qcom,board-id = <0x10008 0>;
};
